## 01_blinky/build/Kconfig/Kconfig.shield
```kconfig
osource "C:/RSingh/zephyr_exercise/01_blinky/boards/shields/*/Kconfig.shield"
osource "C:/ncs/v2.9.0/nrf/boards/shields/*/Kconfig.shield"
```

## 01_blinky/build/Kconfig/Kconfig.shield.defconfig
```kconfig
osource "C:/RSingh/zephyr_exercise/01_blinky/boards/shields/*/Kconfig.defconfig"
osource "C:/ncs/v2.9.0/nrf/boards/shields/*/Kconfig.defconfig"
```
