## CMakeLists.txt
```
cmake_minimum_required(VERSION 3.20.0)
find_package(Zephyr REQUIRED HINTS $ENV{ZEPHYR_BASE})
project(hello_world)
target_sources_ifdef(CONFIG_CALC app PRIVATE src/calc.c)
target_sources(app PRIVATE src/main.c)
```

## KConfig
```
source "kconfig.zephyr"

config CALC
    bool "Enable CALC Module"
    default n
```

## prj.conf
```kconfig
CONFIG_CALC=y #by default as defined in KConfig, it is =n i.e. disabled
```

## src/main.c
```c
#include <zephyr/kernel.h>
#include <zephyr/sys/printk.h>
#ifdef CONFIG_CALC
#include "calc.h"
#endif

int main()
{
    while(1)
    {
#ifdef CONFIG_CALC
        printk("Hello World %d\n", sum(5, 7));
#else
        printk("Hello World\n");
#endif
        k_msleep(100);
    }
}
```

## src/calc.h
```c
#ifndef _CALC_H_
#define _CALC_H_

int sum(int a, int b);

#endif
```
